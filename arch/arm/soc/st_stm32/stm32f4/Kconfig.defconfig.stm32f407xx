## arch/arm/soc/st_stm32/stm32f4/Kconfig.defconfig.stm32f407xx
```kconfig
# Kconfig - ST STM32F407XX MCU configuration options
#
# Copyright (c) 2016 Linaro Limited.
# Copyright (c) 2017 Chunshan Zhu
#
# SPDX-License-Identifier: Apache-2.0
#

if SOC_STM32F407XG|| SOC_STM32F407XE

config SOC
	string
	default stm32f407xx

config NUM_IRQS
	int
	default 82

endif # SOC_STM32F407XG or SOC_STM32F407XE
```

## boards/arm/nucleus_f103ze/Kconfig.board
```kconfig
# Kconfig - STM32F103ZET6 NUCLEUS board configuration
#
# Copyright (c) 2017 Chunshan Zhu
#
# SPDX-License-Identifier: Apache-2.0
#

config BOARD_NUCLEUS_F103ZE
	bool "STM32F103ZET6 nucleus Development Board"
	depends on SOC_STM32F103XE
```

## boards/arm/nucleus_f103ze/Kconfig.defconfig
```kconfig
# Kconfig - STM32F103ZET6 NUCLEUS board configuration
#
# Copyright (c) 2017 Chunshan Zhu.
#
# SPDX-License-Identifier: Apache-2.0
#

if BOARD_NUCLEUS_F103ZE

config BOARD
	default nucleus_f103ze

endif # BOARD_NUCLEUS_F103ZE
```

## boards/arm/nucleus_f407ve/Kconfig.board
```kconfig
# Kconfig - OLIMEX-STM32-E407 board configuration
#
# Copyright (c) 2017, Erwin Rol <erwin@erwinrol.com>
#
# SPDX-License-Identifier: Apache-2.0
#
config BOARD_NUCLEUS_F407VE
	bool "NUCLEUS STM32F407VE Dev Board"
	depends on SOC_STM32F407XE
```

## boards/arm/nucleus_f407ve/Kconfig.defconfig
```kconfig
# Kconfig - OLIMEX-STM32-E407 board configuration
#
# Copyright (c) 2017, Erwin Rol <erwin@erwinrol.com>
#
# SPDX-License-Identifier: Apache-2.0
#

if BOARD_NUCLEUS_F407VE

config BOARD
	default nucleus_f407ve

endif # BOARD_NUCLEUS_F407VE
```
